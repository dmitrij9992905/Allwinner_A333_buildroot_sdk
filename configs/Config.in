## vendor/allwinner-a333/boot/u-boot-2018/drivers/sunxi_power/Kconfig
```kconfig
menuconfig SUNXI_POWER
	bool "Sunxi power device support"
if SUNXI_POWER

config SUNXI_PMU
	bool "Sunxi pmu support"
	---help---
	Select this to enable support for PMU
config SUNXI_BMU
	bool "Sunxi bmu support"
	---help---
	Select this to enable support for BMU
config SUNXI_PMU_EXT
	bool "Sunxi pmu_ext support"
	---help---
	Select this to enable support for PMU_EXT
config SUNXI_PMU_GENERAL
	bool "Sunxi pmu_general support"
	---help---
	Select this to enable support for CONFIG_SUNXI_PMU_GENERAL
config SUNXI_BMU_EXT
	bool "Sunxi bmu_ext support"
	---help---
	Select this to enable support for BMU_EXT

config SUNXI_TRY_POWER_SPLY
	bool "try power sply"
	depends on SUNXI_PMU
	---help---
	Try to find for example axp806_power_sply

config AXPNULL_POWER
	bool "axpdummy support board without a pmic"
	depends on SUNXI_PMU
	---help---
	Select this for boards which do not use a PMIC.

config SUNXI_AXP152_POWER
	bool "pmu axp152 pmic support"
	depends on SUNXI_PMU
	select AXP_PMIC_BUS
	select CMD_POWEROFF
	---help---
	Say y here to enable support for the axp152 pmic found on some
	sun50iw9p1 PMU dev board

config AXP152_SUNXI_I2C_SLAVE
	hex "AXP152 I2C Slave"
	depends on R_I2C0_ENABLE && SUNXI_AXP152_POWER
	default 0
	help
	 Sunxi AXP152 I2C Slave

config AXP221_POWER_SUNXI
	bool "pmu axp221 pmic support"
	depends on SUNXI_PMU
	select AXP_PMIC_BUS
	select CMD_POWEROFF
	---help---
	Say y here to enable support for the axp221 pmic found on some
	sun8iw11p1 PMU dev board

config AXP221_SUNXI_I2C_SLAVE
	hex "AXP221 I2C Slave"
	depends on R_I2C0_ENABLE && AXP221_POWER
	default 0
	help
	 Sunxi AXP221 I2C Slave

config AXP81X_POWER
	bool "pmu axp81X pmic support"
	depends on SUNXI_PMU
	select AXP_PMIC_BUS
	select CMD_POWEROFF
	---help---
	Say y here to enable support for the axp81X pmic found on some
	sun50iw10p1 PMU/PMU dev board

config AXP81X_SUNXI_I2C_SLAVE
	hex "AXP81X I2C Slave"
	depends on R_I2C0_ENABLE && AXP81X_POWER
	default 0
	help
	 Sunxi AXP81X I2C Slave

config AXP2101_POWER
	bool "pmu/bmu axp2101 pmic support"
	depends on SUNXI_PMU
	select AXP_PMIC_BUS
	select CMD_POWEROFF
	---help---
	Say y here to enable support for the axp21 pmic found on some
	sun8iw19p1 PMU/BMU dev board

config AXP2101_SUNXI_I2C_SLAVE
	hex "AXP2101 I2C Slave"
	depends on AXP2101_POWER
	default 0
	help
	 Sunxi AXP2101 I2C Slave

config AXP2202_POWER
	bool "pmu/bmu axp2202 pmic support"
	depends on SUNXI_PMU
	select AXP_PMIC_BUS
	select CMD_POWEROFF
	---help---
	Say y here to enable support for the axp2202 pmic found on some
	sun50iw10p1 PMU/BMU dev board

config AXP2202_SUNXI_I2C_SLAVE
	hex "AXP2202 I2C Slave"
	depends on R_I2C0_ENABLE && AXP2202_POWER
	default 0
	help
	 Sunxi AXP2202 I2C Slave

config AXP858_POWER
	bool "pmu axp858 pmic support"
	depends on SUNXI_PMU
	select AXP_PMIC_BUS
	select CMD_POWEROFF
	---help---
	Say y here to enable support for the axp858 pmic found on some
	A50 PMU dev board

config AXP858_SUNXI_I2C_SLAVE
	hex "AXP858 I2C Slave"
	depends on R_I2C0_ENABLE && AXP858_POWER
	default 0
	help
	 Sunxi AXP858 I2C Slave

config AXP806_POWER
	bool "pmu axp806 pmic support"
	depends on SUNXI_PMU
	select AXP_PMIC_BUS
	select CMD_POWEROFF
	---help---
	Say y here to enable support for the axp81X pmic found on some
	sun50iw9p1 PMU dev board

config AXP806_SUNXI_I2C_SLAVE
	hex "AXP806 I2C Slave"
	depends on R_I2C0_ENABLE && AXP806_POWER
	default 0
	help
	 Sunxi AXP806 I2C Slave

config AXP1530_POWER
	bool "pmu axp1530 pmic support"
	depends on SUNXI_PMU
	select AXP_PMIC_BUS
	select CMD_POWEROFF
	---help---
	Say y here to enable support for the axp1530 pmic found on some
	sun50iw9p1 PMU dev board

config AXP1530_SUNXI_I2C_SLAVE
	hex "AXP1530 I2C Slave"
	depends on AXP1530_POWER
	depends on R_I2C0_ENABLE || I2C0_ENABLE
	default 0
	help
	 Sunxi AXP1530 I2C Slave

config AXP8191_POWER
	bool "pmu/bmu axp8191 pmic support"
	depends on SUNXI_PMU
	select AXP_PMIC_BUS
	select CMD_POWEROFF
	---help---
	Say y here to enable support for the axp8191 pmic found on some
	sun55iw3p1 PMU dev board

config AXP8191_SUNXI_I2C_SLAVE
	hex "AXP8191 I2C Slave"
	depends on R_I2C0_ENABLE && AXP8191_POWER
	default 0
	help
	 Sunxi AXP8191 I2C Slave

config AXP515_POWER
	bool "bmu axp515 pmic support"
	depends on SUNXI_BMU
	select AXP_PMIC_BUS
	select CMD_POWEROFF
	---help---
	Say y here to enable support for the axp515 pmic found on some
	A50 BMU dev board

config AXP515_SUNXI_I2C_SLAVE
	hex "AXP515 I2C Slave"
	depends on R_I2C0_ENABLE && AXP515_POWER
	default 0
	help
	 Sunxi AXP515 I2C Slave

config AXP517_POWER
	bool "bmu axp517 pmic support"
	depends on SUNXI_BMU
	select AXP_PMIC_BUS
	select CMD_POWEROFF
	---help---
	Say y here to enable support for the axp517 pmic found on some
	A50 BMU dev board

config AXP517_SUNXI_I2C_SLAVE
	hex "AXP517 I2C Slave"
	depends on R_I2C0_ENABLE && AXP517_POWER
	default 0
	help
	 Sunxi AXP517 I2C Slave

config AXP2601_POWER
	bool "bmu axp2601 pmic support"
	depends on SUNXI_BMU
	select AXP_PMIC_BUS
	select CMD_POWEROFF
	---help---
	Say y here to enable support for the single axp2601 pmic

config AXP2601_SUNXI_I2C_SLAVE
	hex "AXP2601 I2C Slave"
	depends on R_I2C0_ENABLE && AXP2601_POWER
	default 0
	help
	 Sunxi AXP2601 I2C Slave

config TCS4838_POWER
	bool "pmu tcs4838 pmic support"
	depends on SUNXI_PMU
	select AXP_PMIC_BUS
	select CMD_POWEROFF
	---help---
	Say y here to enable support for the tcs4838 pmic found on some
	sun50iw10p1 PMU dev board, with axp2202

config SY8827G_POWER
	bool "pmu sy8827g pmic support"
	depends on SUNXI_PMU
	select AXP_PMIC_BUS
	select CMD_POWEROFF
	---help---
	Say y here to enable support for the sy8827g pmic found on some
	sun50iw10p1 PMU dev board, with axp2202

config OCP2131_POWER
	bool "pmu ocp2131 pmic support"
	depends on SUNXI_PMU_GENERAL
	select AXP_PMIC_BUS
	select CMD_POWEROFF
	---help---
	Say y here to enable support for the ocp2131 pmic

config OCP2131_SUNXI_I2C_SLAVE
	hex "OCP2131 I2C Slave"
	depends on OCP2131_POWER
	default 0
	help
	 Sunxi OCP2131 I2C Slave

config AW37501_POWER
	bool "pmu aw37501 pmic support"
	depends on SUNXI_PMU_GENERAL
	select AXP_PMIC_BUS
	select CMD_POWEROFF
	---help---
	Say y here to enable support for the aw37501 pmic

config AW37501_SUNXI_I2C_SLAVE
	hex "AW37501 I2C Slave"
	depends on AW37501_POWER
	default 0
	help
	 Sunxi AW37501 I2C Slave

config ETA6973_POWER
	bool "bmu eta6973 pmic support"
	depends on SUNXI_BMU_EXT
	select AXP_PMIC_BUS
	select CMD_POWEROFF
	---help---
	Say y here to enable support for the eta6973 pmic found on some
	sun55iw3p1 PMU dev board, with axp2202

config ETA6973_SUNXI_I2C_SLAVE
	hex "ETA6973 I2C Slave"
	depends on R_I2C0_ENABLE && ETA6973_POWER
	default 0
	help
	 Sunxi ETA6973 I2C Slave

config AXP519_POWER
	bool "bmu axp519 pmic support"
	depends on SUNXI_BMU_EXT
	select AXP_PMIC_BUS
	select CMD_POWEROFF
	---help---
	Say y here to enable support for the axp519 & axp2601 pmic found on some
	sun55iw3p1 PMU dev board, with axp2202

config AXP519_SUNXI_I2C_SLAVE
	hex "AXP519 I2C Slave"
	depends on R_I2C0_ENABLE && AXP519_POWER
	default 0
	help
	 Sunxi AXP519 I2C Slave

config SUNXI_UBOOT_POWER_OFF
	bool "Sunxi uboot power off"
	---help---
	Select this to enable support for uboot power off

config SUNXI_GPIO_NOT_CTRL_BY_POWER
	default y if SUNXI_GPIO_POWER_VOL_MODE
	bool "Sunxi gpio function not control by power manager"
	---help---
	Select this to disable power manager control gpio

endif
```

## vendor/allwinner-a333/bsp/drivers/amp_rsc/Kconfig
```kconfig
# SPDX-License-Identifier: GPL-2.0-or-later
menu "Resource Isolation Driver"

config AW_AMP_SYS_RSC_MANAGER
	bool "Enable Allwinner AMP System Resourece Manager(ASRM)"
	select AW_RPROC_SUBDEV
	select AW_RPROC_SUBDEV_RSC_HELPER
	select AW_RPROC_USER_RESOURCE
	default n

config AW_CURRENT_AMP_SYS_RSC_USER_ID
	int "Current AMP system resource user id in ASRM"
	depends on AW_AMP_SYS_RSC_MANAGER
	default 0
	help
	  Current AMP system resource user id, depend on specific platform.
	  You can find all available user id in lowlevel/platform/platform_rsc_user_id.h.

config AW_ASRM_PROVIDE_PERI_CLK_INFO
	bool "ASRM provide peripheral clock info for CCU driver"
	depends on AW_AMP_SYS_RSC_MANAGER
	default y

config AW_GPIO_ISOLATION_DRIVER
	bool "Enable GPIO Isolation Driver"
	depends on AW_AMP_SYS_RSC_MANAGER
	default n

config AW_DMA_ISOLATION_DRIVER
	bool "Enable DMA Isolation Driver"
	depends on AW_AMP_SYS_RSC_MANAGER
	default n

config AW_AMP_SYS_RSC_MANAGER_TEST
	bool "ASRM test command"
	depends on AW_AMP_SYS_RSC_MANAGER
	default n

endmenu
```

## vendor/allwinner-a333/bsp/drivers/asic/Kconfig
```kconfig
# SPDX-License-Identifier: GPL-2.0-only

menu "Sunxi asic demo Drivers"
	depends on AW_BSP

config AW_ASIC_SPI_DEMO_SPI2APB
	depends on AW_SPI_NG
	tristate "Asic spi demo drivers for AW spi2apb"
	default n

config AW_ASIC_SPI_DEMO_INOVANCE
	depends on AW_SPI_NG
	tristate "Asic spi demo drivers for inovance"
	default n

config AW_ASIC_SDIO_DEMO
	tristate "Asic sdio demo drivers"
	default n

config AW_ASIC_LOCALBUS_DEMO
	tristate "Asic localbus demo drivers"
	default n
endmenu
```

## vendor/allwinner-a333/bsp/drivers/chips/Kconfig
```kconfig
# SPDX-License-Identifier: GPL-2.0-only

config AW_CHIPS
	tristate "Chip LeveL APIs for Allwinner SoCs"
	depends on AW_BSP
	default n
	help
	  Provide chip level APIs for Allwinner SoCs.
```

## vendor/allwinner-a333/bsp/drivers/dma-buf/Kconfig
```kconfig
# SPDX-License-Identifier: GPL-2.0-only

menu "Carveout Drivers"
	depends on AW_BSP

config AW_DMABUF_HEAPS_CARVEOUT
	bool "Carveout Heaps"
	depends on DMABUF_HEAPS
	help
	  Choose this option to enable the carveout dmabuf heap. The carveout
	  heap is backed by pages from reserved memory regions flagged as
	  exportable. If in doubt, say Y.

config AW_DMABUF_HEAPS_CARVEOUT_DEBUG
	bool "Carveout Heaps debug"
	depends on AW_DMABUF_HEAPS_CARVEOUT
	help
	  Choose this option to enable the carveout dmabuf heap debug.

endmenu
```

## vendor/allwinner-a333/bsp/drivers/misc/sunxi-timestamp/Kconfig
```kconfig
# SPDX-License-Identifier: GPL-2.0-only
config AW_TIMESTAMP
	bool "enable sunxi timestamp"
	default n
```

## vendor/allwinner-a333/bsp/drivers/net/wireless/aic8800/Kconfig
```kconfig
config AIC_WLAN_SUPPORT
	bool "AIC wireless Support"
	default n
	help
	  This is support for aic wireless chip.

config AIC_FW_PATH
	depends on AIC_WLAN_SUPPORT
	string "Firmware & config file path"
	default "/vendor/etc/firmware"
	#default "/lib/firmware/aic8800_sdio"
	help
	  Path to the firmware & config file.

config PLATFORM_ALLWINNER
       bool "Allow Android config"
       depends on AIC_WLAN_SUPPORT
       default n
       help
               choice android config

config PLATFORM_UBUNTU
       bool "Allow Ubuntu config"
       depends on AIC_WLAN_SUPPORT
       default n
       help
               choice linux config

config USE_P2P0
       bool "Allow Ubuntu p2p0 config"
       depends on AIC_WLAN_SUPPORT
       default n
       help
               choice linux p2p0 config

if AIC_WLAN_SUPPORT
source "$(BSP_TOP)drivers/net/wireless/aic8800/aic8800_fdrv/Kconfig"
source "$(BSP_TOP)drivers/net/wireless/aic8800/aic8800_btlpm/Kconfig"
endif
```

## vendor/allwinner-a333/bsp/drivers/net/wireless/seekwave/Kconfig
```kconfig
source "$(BSP_TOP)drivers/net/wireless/seekwave/seekwaveplatform/Kconfig"
source "$(BSP_TOP)drivers/net/wireless/seekwave/skw_drivers/Kconfig"
```

## vendor/allwinner-a333/bsp/drivers/net/wireless/seekwave/seekwaveplatform/Kconfig
```kconfig
menuconfig SEEKWAVE_BSP_DRIVERS
	bool "SeekWave Platform Drivers For SeekWave Chip"
	default n
	help
	This is support seekwave chip for incard board
	if you want to buildin bsp driver
	please say "y"
	Thanks.

config SEEKWAVE_PLD_RELEASE
    bool "seekwave Platfrom support chip recoverymode"
    depends on SEEKWAVE_BSP_DRIVERS
    default n

#seekwave`s wifi bluetooth device driver etc
if  SEEKWAVE_BSP_DRIVERS
#source "$(BSP_TOP)drivers/net/wireless/seekwave/seekwaveplatform/usb/Kconfig"
source "$(BSP_TOP)drivers/net/wireless/seekwave/seekwaveplatform/sdio/Kconfig"
source "$(BSP_TOP)drivers/net/wireless/seekwave/seekwaveplatform/skwutil/Kconfig"
endif
```
