## vendor/allwinner-a333/boot/u-boot-2018/configs/sun300iw1p1_v821_ver1_defconfig
```kconfig
CONFIG_RISCV=y
CONFIG_SYS_CONFIG_NAME="sun300iw1p1"
CONFIG_SYS_TEXT_BASE=0x82000000
CONFIG_SUNXI_SECURE_BOOT=y
CONFIG_SUNXI_FDT_ADDR=0x81fe0000
CONFIG_RISCV_NDS=y
CONFIG_CPU_A27L2=y
CONFIG_SUNXI_ANTI_BRUSH=y
CONFIG_MACH_SUN300IW1=y
CONFIG_SUNXI_RISCV_MODE=y
CONFIG_DEFAULT_DEVICE_TREE="sun300iw1p1-soc-system"
# CONFIG_SYS_MALLOC_CLEAR_ON_INIT is not set
CONFIG_ANDROID_BOOT_IMAGE=y
CONFIG_CONSOLE_MUX=y
CONFIG_RESERVE_FDT_SIZE=0x20000
CONFIG_SUNXI_MALLOC_LEN=0x600000
CONFIG_SUNXI_MAC=y
CONFIG_SUNXI_USER_KEY=y
CONFIG_SUNXI_NECESSARY_REPLACE_FDT=y
CONFIG_SUNXI_COMP_DETECT=y
CONFIG_CMD_FASTBOOT=y
# CONFIG_CMD_GPT is not set
# CONFIG_SUNXI_SECURE_STORAGE is not set
CONFIG_CMD_PART=y
CONFIG_CMD_SUNXI_TIMER=y
CONFIG_CMD_SUNXI_SPRITE=y
CONFIG_CMD_SUNXI_BURN=y
CONFIG_CMD_SUNXI_BOOTR=y
CONFIG_EFI_PARTITION=y
CONFIG_CLK_SUNXI=y
# CONFIG_CPU is not set
CONFIG_SUNXI_DMA=y
CONFIG_SUNXI_GPIO_V2=y
CONFIG_MMC=y
CONFIG_SPI_FLASH=y
CONFIG_SF_DEFAULT_MODE=0x3000
CONFIG_SF_DEFAULT_SPEED=50000000
CONFIG_SPI_SAMP_DL_EN=y
CONFIG_SPI_FLASH_ATMEL=y
CONFIG_SPI_FLASH_EON=y
CONFIG_SPI_FLASH_GIGADEVICE=y
CONFIG_SPI_FLASH_ISSI=y
CONFIG_SPI_FLASH_MACRONIX=y
CONFIG_SPI_FLASH_SPANSION=y
CONFIG_SPI_FLASH_STMICRO=y
CONFIG_SPI_FLASH_SST=y
CONFIG_SPI_FLASH_WINBOND=y
CONFIG_SPI_FLASH_XMC=y
CONFIG_SPI_FLASH_PUYA=y
CONFIG_SPI_FLASH_FM=y
CONFIG_SPI_FLASH_XT=y
CONFIG_PWM_NOT_USE=y
CONFIG_SPI=y
CONFIG_SUNXI_SPI=y
CONFIG_SUNXI_SPIF=y
CONFIG_SUNXI_NAND=y
CONFIG_SUNXI_UBIFS=y
CONFIG_SUNXI_SDMMC=y
CONFIG_SUNXI_USB=y
CONFIG_SUNXI_EFEX=y
CONFIG_SUNXI_BURN=y
CONFIG_NOT_USE_OPTEE25=y
CONFIG_SUNXI_SBI_ECALL=y
CONFIG_SUNXI_SPRITE=y
CONFIG_SUNXI_SPRITE_CARTOON=y
CONFIG_SUNXI_AUTO_UPDATE=y
CONFIG_LZ4=y
CONFIG_NETDEVICES=y
CONFIG_SUNXI_GMAC=y
CONFIG_NET=y
CONFIG_NET_RANDOM_ETHADDR=y
CONFIG_CMD_MII=y
CONFIG_CMD_NET=y
CONFIG_CMD_TFTPBOOT=y
CONFIG_NET_TFTP_VARS=y
CONFIG_CMD_NFS=y
CONFIG_CMD_PING=y

# Environment
CONFIG_ENV_IS_IN_SUNXI_FLASH=y
CONFIG_SYS_MAXARGS=64
CONFIG_SUNXI_REDUNDAND_ENVIRONMENT=y
CONFIG_SYS_REDUNDAND_ENVIRONMENT=y
CONFIG_SUNXI_ENV_PARTITION="env"
CONFIG_SUNXI_ENV_REDUNDAND_PARTITION="env-redund"
CONFIG_ENV_SIZE=0x20000

#
# BOOT GUI
#
CONFIG_BOOT_GUI=y
# CONFIG_UPDATE_DISPLAY_MODE is not set
# CONFIG_CONFIG_LCD_CHECK_SKIP_OPEN is not set
# CONFIG_BOOT_GUI_DOUBLE_BUF is not set
# CONFIG_BOOT_GUI_TEST is not set

#
# SUNXI LOGO DISPLAY
#
CONFIG_CMD_SUNXI_BMP=y
CONFIG_SUNXI_ADVERT_PICTURE=y
CONFIG_LZMA=y
# CONFIG_SUNXI_SPINOR_BMP is not set
# CONFIG_ENABLE_ADVERT_PICTURE is not set
# CONFIG_CMD_SUNXI_JPEG is not set
CONFIG_DISP2_SUNXI=y
# CONFIG_HDMI_DISP2_SUNXI is not set
# CONFIG_HDMI2_DISP2_SUNXI is not set
# CONFIG_INNO_PHY is not set
# CONFIG_VDPO_DISP2_SUNXI is not set
# CONFIG_TV_DISP2_SUNXI=y
# CONFIG_DISP2_TV_GM7121 is not set
# CONFIG_DISP2_TV_AC200 is not set
# CONFIG_EDP_DISP2_SUNXI is not set
# CONFIG_EINK_PANEL_USED is not set

#
# LCD panels select
#
# CONFIG_LCD_SUPPORT_K101IM2QA04 is not set
# CONFIG_LCD_SUPPORT_K101IM2BYL02L is not set
# CONFIG_LCD_SUPPORT_BP101WX1 is not set
# CONFIG_LCD_SUPPORT_FX070 is not set
# CONFIG_LCD_SUPPORT_K080_IM2HYL802R_800X1280 is not set
# CONFIG_LCD_SUPPORT_K101_IM2BYL02_L_800X1280 is not set
# CONFIG_LCD_SUPPORT_GG1P4062UTSW is not set
# CONFIG_LCD_SUPPORT_DX0960BE40A1 is not set
# CONFIG_LCD_SUPPORT_TFT720X1280 is not set
# CONFIG_LCD_SUPPORT_FD055HD003S is not set
# CONFIG_LCD_SUPPORT_HE0801A068 is not set
# CONFIG_LCD_SUPPORT_ILI9341 is not set
# CONFIG_LCD_SUPPORT_LH219WQ1 is not set
# CONFIG_LCD_SUPPORT_LS029B3SX02 is not set
# CONFIG_LCD_SUPPORT_LT070ME05000 is not set
# CONFIG_LCD_SUPPORT_S6D7AA0X01 is not set
CONFIG_LCD_SUPPORT_T27P06=y
# CONFIG_LCD_SUPPORT_TFT720x1280 is not set
# CONFIG_LCD_SUPPORT_WTQ05027D01 is not set
# CONFIG_LCD_SUPPORT_H245QBN02 is not set
# CONFIG_LCD_SUPPORT_ST7789V is not set
# CONFIG_LCD_SUPPORT_ST7796S is not set
# CONFIG_LCD_SUPPORT_ST7701S is not set
# CONFIG_LCD_SUPPORT_T30P106 is not set
# CONFIG_LCD_SUPPORT_TO20T20000 is not set
# CONFIG_LCD_SUPPORT_FRD450H40014 is not set
# CONFIG_LCD_SUPPORT_S2003T46G is not set
# CONFIG_LCD_SUPPORT_WILLIAMLCD is not set
# CONFIG_LCD_SUPPORT_LQ101R1SX03 is not set
# CONFIG_LCD_SUPPORT_INET_DSI_PANEL is not set
# CONFIG_LCD_SUPPORT_WTL096601G03 is not set
# CONFIG_LCD_SUPPORT_WTL096601G03 is not set
# CONFIG_LCD_SUPPORT_CC10127007_31AB is not set

#
# Display engine feature select
#
# CONFIG_DISP2_SUNXI_SUPPORT_SMBL is not set
# CONFIG_DISP2_SUNXI_SUPPORT_ENAHNCE is not set

CONFIG_CMD_SUNXI_AUTO_FEL=y
CONFIG_SUNXI_SERIAL=y

# rtos
CONFIG_BOOT_RISCV=y
CONFIG_CMD_SUNXI_BOOTRV=y
CONFIG_SUNXI_VERIFY_RISCV=y
CONFIG_SUNXI_IMAGE_HEADER=y
```

## vendor/allwinner-a333/boot/u-boot-2018/configs/sun50iw15p1_fpga_defconfig
```kconfig
CONFIG_ARM=y
CONFIG_SYS_CONFIG_NAME="sun50iw15p1"
CONFIG_ARM_SMCCC=y
CONFIG_SYS_TEXT_BASE=0x4A000000
CONFIG_SUNXI_SECURE_BOOT=y
CONFIG_MACH_SUN50IW15=y
CONFIG_R_I2C0_ENABLE=y
CONFIG_DEFAULT_DEVICE_TREE="sun50iw15p1-soc-system"
# CONFIG_SYS_MALLOC_CLEAR_ON_INIT is not set
CONFIG_PHYS_64BIT=y
CONFIG_ANDROID_BOOT_IMAGE=y
CONFIG_CONSOLE_MUX=y
CONFIG_SUNXI_KEYBOX=y
CONFIG_SUNXI_SERIAL=y
CONFIG_ANDROID_AB=y
CONFIG_SUNXI_MAC=y
CONFIG_SUNXI_USER_KEY=y
CONFIG_SUNXI_DRM_SUPPORT=y
CONFIG_SUNXI_ANDROID_BOOT=y
CONFIG_SUNXI_VERIFY_BOOT_INFO_INSTALL=y
CONFIG_SUNXI_NECESSARY_REPLACE_FDT=y
CONFIG_SUNXI_FPGA_PLATFORM=y
CONFIG_CMD_FASTBOOT=y
CONFIG_CMD_PART=y
CONFIG_CMD_SUNXI_TIMER=y
CONFIG_CMD_SUNXI_SPRITE=y
CONFIG_CMD_SUNXI_BURN=y
CONFIG_CMD_SUNXI_MEMTEST=y
CONFIG_SUNXI_DMA=y
CONFIG_SYS_I2C_SUNXI=y
CONFIG_SYS_SUNXI_R_I2C0_SPEED=400000
CONFIG_SYS_SUNXI_R_I2C0_SLAVE=0x34
CONFIG_MMC=y
CONFIG_PWM_NOT_USE=y
CONFIG_SUNXI_SDMMC=y
CONFIG_SUNXI_USB=y
CONFIG_SUNXI_EFEX=y
CONFIG_SUNXI_BURN=y
CONFIG_SUNXI_CE_21=y
CONFIG_SUNXI_SPRITE=y
CONFIG_SUNXI_SPRITE_CARTOON=y
```

## vendor/allwinner-a333/boot/u-boot-2018/configs/sun50iw15p1_h726_defconfig
```kconfig
CONFIG_ARM=y
CONFIG_SYS_CONFIG_NAME="sun50iw15p1"
CONFIG_ARM_SMCCC=y
CONFIG_SYS_TEXT_BASE=0x4A000000
CONFIG_SUNXI_SECURE_BOOT=y
CONFIG_SUNXI_WDT_V2=y
CONFIG_MACH_SUN50IW15=y
CONFIG_DEFAULT_DEVICE_TREE="sun50iw15p1-soc-system"
# CONFIG_SYS_MALLOC_CLEAR_ON_INIT is not set
CONFIG_PHYS_64BIT=y
CONFIG_ANDROID_BOOT_IMAGE=y
CONFIG_BOOTSTAGE=y
CONFIG_BOOTSTAGE_REPORT=y
CONFIG_CONSOLE_MUX=y
CONFIG_SUNXI_NECESSARY_REPLACE_FDT=y
CONFIG_CMD_FASTBOOT=y
CONFIG_CMD_PART=y
CONFIG_CMD_SUNXI_TIMER=y
CONFIG_CMD_SUNXI_SPRITE=y
CONFIG_CMD_SUNXI_BURN=y
CONFIG_CMD_SUNXI_MEMTEST=y
CONFIG_SUNXI_DMA=y
CONFIG_SUNXI_GPIO_V2=y
CONFIG_MMC=y
CONFIG_PWM_NOT_USE=y
CONFIG_SUNXI_SDMMC=y
CONFIG_SUNXI_USB=y
CONFIG_SUNXI_EFEX=y
CONFIG_SUNXI_BURN=y
CONFIG_SUNXI_SPRITE=y
CONFIG_SUNXI_SPRITE_CARTOON=y
# CONFIG_SUNXI_TURNNING_DRAM is not set
```

## vendor/allwinner-a333/boot/u-boot-2018/configs/sun55iw7p1_fpga_defconfig
```kconfig
CONFIG_ARM=y
CONFIG_ARM_SMCCC=y
CONFIG_SYS_TEXT_BASE=0x43000000
CONFIG_MACH_SUN55IW7=y
CONFIG_SUNXI_FDT_ADDR=0x42000000
CONFIG_DEFAULT_DEVICE_TREE="sun55iw7p1-soc-system"
CONFIG_PHYS_64BIT=y
CONFIG_ANDROID_BOOT_IMAGE=y
CONFIG_LOGLEVEL=6
CONFIG_PRE_CON_BUF_SZ=1024
CONFIG_SUNXI_FPGA_PLATFORM=y
CONFIG_CMD_GPIO=y
CONFIG_CMD_LOG=y
CONFIG_CMD_SUNXI_CLK=y
# CONFIG_NET is not set
CONFIG_CLK_SUNXI=y
CONFIG_MMC=y
CONFIG_DM_PMIC=y
CONFIG_DM_REGULATOR=y
CONFIG_PWM_NOT_USE=y
CONFIG_SUNXI_SDMMC=y
CONFIG_RSA=y
CONFIG_OPENSSL=y
CONFIG_SUNXI_SPRITE=y
```

## vendor/allwinner-a333/boot/u-boot-2018/configs/sun65iw1p1_a537_defconfig
```kconfig
CONFIG_ARM=y
CONFIG_ARM_SMCCC=y
CONFIG_MACH_SUN65IW1=y
CONFIG_SUNXI_FDT_ADDR=0x42000000
CONFIG_I2C5_ENABLE=y
CONFIG_R_I2C0_ENABLE=y
CONFIG_USB0_VBUS_PIN="PL12"
CONFIG_USB1_VBUS_PIN="PL8"
CONFIG_DEFAULT_DEVICE_TREE="sun65iw1p1-soc-system"
# CONFIG_CC_OPTIMIZE_FOR_SIZE is not set
CONFIG_PHYS_64BIT=y
CONFIG_SUPPORT_HYPERVISOR=y
CONFIG_ANDROID_BOOT_IMAGE=y
CONFIG_LOGLEVEL=6
CONFIG_PRE_CON_BUF_SZ=1024
# CONFIG_CONSOLE_MUX is not set
CONFIG_SYS_CONSOLE_IS_IN_ENV=y
CONFIG_SUNXI_IMAGE_VERIFIER=y
CONFIG_SUNXI_KEYBOX=y
CONFIG_SUNXI_SERIAL=y
CONFIG_ANDROID_AB=y
CONFIG_SUNXI_MAC=y
CONFIG_SUNXI_USER_KEY=y
CONFIG_SUNXI_DRM_SUPPORT=y
CONFIG_SUNXI_ANDROID_BOOT=y
CONFIG_SUNXI_VERIFY_BOOT_INFO_INSTALL=y
CONFIG_SUNXI_NECESSARY_REPLACE_FDT=y
CONFIG_SUNXI_HOMLET=y
CONFIG_RECOVERY_KEY=y
CONFIG_SUNXI_RKP=y
CONFIG_SUNXI_RNG_SEED=y
CONFIG_SUNXI_RECORD_LOG=y
CONFIG_SUNXI_RECORD_LOG_PARTITION="pstore"
CONFIG_CMD_FASTBOOT=y
CONFIG_CMD_GPIO=y
CONFIG_CMD_USB=y
CONFIG_CMD_LOG=y
CONFIG_CMD_SUNXI_CLK=y
CONFIG_CMD_SUNXI_SPRITE=y
CONFIG_CMD_SUNXI_BURN=y
CONFIG_LAST_PARTITION_NAME="userdata"
# CONFIG_NET is not set
CONFIG_SUNXI_GPADC=y
CONFIG_CLK_SUNXI=y
CONFIG_SUNXI_DRAM_SELECT_RECORD=y
CONFIG_SUNXI_DMA=y
CONFIG_AW_GPIO_V4=y
CONFIG_SYS_I2C_SUNXI=y
CONFIG_SYS_SUNXI_R_I2C0_SLAVE=0x34
CONFIG_MMC=y
CONFIG_SPI_FLASH=y
CONFIG_SF_DEFAULT_MODE=0x3000
CONFIG_SF_DEFAULT_SPEED=20000000
CONFIG_SPI_SAMP_DL_EN=y
CONFIG_SPI_FLASH_ATMEL=y
CONFIG_SPI_FLASH_EON=y
CONFIG_SPI_FLASH_GIGADEVICE=y
CONFIG_SPI_FLASH_ISSI=y
CONFIG_SPI_FLASH_MACRONIX=y
CONFIG_SPI_FLASH_SPANSION=y
CONFIG_SPI_FLASH_STMICRO=y
CONFIG_SPI_FLASH_SST=y
CONFIG_SPI_FLASH_WINBOND=y
CONFIG_SPI_FLASH_XMC=y
CONFIG_SPI_FLASH_PUYA=y
CONFIG_SPI_FLASH_FM=y
CONFIG_SPI_FLASH_XT=y
CONFIG_DM_PMIC=y
CONFIG_BAUDRATE=1500000
CONFIG_SPI=y
CONFIG_SUNXI_SPI=y
CONFIG_SPI_USE_DMA=y
CONFIG_SUNXI_POWER=y
CONFIG_SUNXI_PMU=y
CONFIG_SUNXI_BMU=y
CONFIG_SUNXI_PMU_EXT=y
CONFIG_AXP2202_POWER=y
CONFIG_AXP2202_SUNXI_I2C_SLAVE=0x34
CONFIG_AXP1530_POWER=y
CONFIG_AXP1530_SUNXI_I2C_SLAVE=0x36
CONFIG_AW37501_POWER=y
CONFIG_AW37501_SUNXI_I2C_SLAVE=0x3e
CONFIG_SUNXI_UBOOT_POWER_OFF=y
CONFIG_SUNXI_GPIO_NOT_CTRL_BY_POWER=y
CONFIG_USB=y
CONFIG_USB_EHCI_HCD=y
CONFIG_USB_DWC3=y
CONFIG_USB_DWC3_GADGET=y
CONFIG_USB_DWC3_PHY_SUNXI=y
CONFIG_USB_STORAGE=y
CONFIG_USB_GADGET=y
CONFIG_USB_GADGET_DOWNLOAD=y
CONFIG_USB_FUNCTION_SUNXI_USB=y
CONFIG_AW_DRM=y
CONFIG_AW_DRM_LVDS=y
CONFIG_AW_DRM_RGB=y
CONFIG_AW_DRM_DSI=y
# CONFIG_AW_DRM_HDMI_TX is not set
CONFIG_AW_DRM_EDP=y
CONFIG_AW_DRM_INNO_EDP13=y
# CONFIG_AW_DRM_EINK200 is not set
CONFIG_AW_DRM_PANEL=y
CONFIG_PANEL_DSI_GENERAL=y
CONFIG_PANEL_LVDS_GENERAL=y
CONFIG_PANEL_RGB_GENERAL=y
CONFIG_PANEL_EDP_GENERAL=y
CONFIG_AW_DRM_PHY=y
CONFIG_SPINOR_LOGICAL_OFFSET=2144
CONFIG_SUNXI_SDMMC=y
CONFIG_SUNXI_USB=y
CONFIG_SUNXI_EFEX=y
CONFIG_SUNXI_BURN=y
CONFIG_SUNXI_CE_30=y
CONFIG_SUNXI_ARISC_EXIST=y
CONFIG_ARISC_DEASSERT_BEFORE_KERNEL=y
CONFIG_RSA=y
CONFIG_SUNXI_ANDROID_OVERLAY=y
CONFIG_SUNXI_SPRITE=y
CONFIG_SECURE_STORAGE_KEY_HUK=y
CONFIG_SUNXI_SPRITE_CARTOON=y
CONFIG_SUNXI_UPDATE_GPT=y
CONFIG_SUNXI_BOOT_PARAM=y
```

## vendor/allwinner-a333/boot/u-boot-2018/configs/sun65iw1p1_a537_nor_defconfig
```kconfig
CONFIG_ARM=y
CONFIG_ARM_SMCCC=y
CONFIG_MACH_SUN65IW1=y
CONFIG_SUNXI_FDT_ADDR=0x42000000
CONFIG_I2C5_ENABLE=y
CONFIG_R_I2C0_ENABLE=y
CONFIG_DEFAULT_DEVICE_TREE="sun65iw1p1-soc-system"
CONFIG_PHYS_64BIT=y
CONFIG_ANDROID_BOOT_IMAGE=y
CONFIG_BOOTSTAGE=y
CONFIG_BOOTSTAGE_REPORT=y
CONFIG_LOGLEVEL=6
CONFIG_PRE_CON_BUF_SZ=1024
# CONFIG_CONSOLE_MUX is not set
CONFIG_SYS_CONSOLE_IS_IN_ENV=y
CONFIG_SUNXI_IMAGE_VERIFIER=y
CONFIG_SUNXI_NOR_IMG=y
CONFIG_SUNXI_SERIAL=y
CONFIG_ANDROID_AB=y
CONFIG_SUNXI_MAC=y
CONFIG_SUNXI_USER_KEY=y
CONFIG_SUNXI_DRM_SUPPORT=y
CONFIG_SUNXI_ANDROID_BOOT=y
CONFIG_SUNXI_VERIFY_BOOT_INFO_INSTALL=y
CONFIG_SUNXI_NECESSARY_REPLACE_FDT=y
CONFIG_SUNXI_HOMLET=y
CONFIG_RECOVERY_KEY=y
CONFIG_SUNXI_RKP=y
CONFIG_SUNXI_RNG_SEED=y
CONFIG_CMD_FASTBOOT=y
CONFIG_CMD_GPIO=y
CONFIG_CMD_LOG=y
CONFIG_CMD_SUNXI_CLK=y
CONFIG_CMD_SUNXI_SPRITE=y
CONFIG_CMD_SUNXI_BURN=y
CONFIG_CMD_SUNXI_AUTO_FEL=y
# CONFIG_DOS_PARTITION is not set
CONFIG_LAST_PARTITION_NAME="userdata"
# CONFIG_NET is not set
CONFIG_SUNXI_GPADC=y
CONFIG_CLK_SUNXI=y
CONFIG_SUNXI_DMA=y
CONFIG_AW_GPIO_V4=y
CONFIG_SYS_I2C_SUNXI=y
CONFIG_SYS_SUNXI_R_I2C0_SLAVE=0x34
CONFIG_AXP1530_SUNXI_I2C_SLAVE=0x36
CONFIG_AXP2202_SUNXI_I2C_SLAVE=0x34
CONFIG_AW37501_SUNXI_I2C_SLAVE=0x3e
CONFIG_MMC=y
CONFIG_DM_PMIC=y
CONFIG_BAUDRATE=1500000
CONFIG_SUNXI_POWER=y
CONFIG_SUNXI_DMA=y
CONFIG_SUNXI_PMU=y
CONFIG_SUNXI_BMU=y
CONFIG_SUNXI_PMU_EXT=y
CONFIG_SUNXI_PMU_GENERAL=y
CONFIG_AXP2202_POWER=y
CONFIG_AXP1530_POWER=y
CONFIG_AW37501_POWER=y
CONFIG_SUNXI_UBOOT_POWER_OFF=y
CONFIG_SUNXI_GPIO_NOT_CTRL_BY_POWER=y
#CONFIG_USB=y
CONFIG_AW_DRM=y
CONFIG_AW_DRM_DSI=y
# CONFIG_AW_DRM_HDMI_TX is not set
# CONFIG_AW_DRM_EINK200 is not set
CONFIG_AW_DRM_PANEL=y
CONFIG_PANEL_DSI_GENERAL=y
CONFIG_AW_DRM_PHY=y
CONFIG_SUNXI_SDMMC=y
CONFIG_SUNXI_USB=y
CONFIG_SUNXI_EFEX=y
CONFIG_SUNXI_CE_30=y
CONFIG_SUNXI_ARISC_EXIST=y
CONFIG_ARISC_DEASSERT_BEFORE_KERNEL=y
CONFIG_RSA=y
CONFIG_SUNXI_ANDROID_OVERLAY=y
CONFIG_SUNXI_SPRITE=y
CONFIG_SUNXI_SPRITE_CARTOON=y
CONFIG_SUNXI_UPDATE_GPT=y
CONFIG_SUNXI_BOOT_PARAM=y
CONFIG_SPI_FLASH=y
CONFIG_SF_DEFAULT_MODE=0x3000
CONFIG_SF_DEFAULT_SPEED=20000000
CONFIG_SPINOR_LOGICAL_OFFSET=2144
CONFIG_SPI_SAMP_DL_EN=y
CONFIG_SPI_FLASH_ATMEL=y
CONFIG_SPI_FLASH_EON=y
CONFIG_SPI_FLASH_GIGADEVICE=y
CONFIG_SPI_FLASH_ISSI=y
CONFIG_SPI_FLASH_MACRONIX=y
CONFIG_SPI_FLASH_SPANSION=y
CONFIG_SPI_FLASH_STMICRO=y
CONFIG_SPI_FLASH_SST=y
CONFIG_SPI_FLASH_WINBOND=y
CONFIG_SPI_FLASH_XMC=y
CONFIG_SPI_FLASH_PUYA=y
CONFIG_SPI_FLASH_FM=y
CONFIG_SPI_FLASH_XT=y
CONFIG_SPI=y
CONFIG_SUNXI_SPI=y
CONFIG_SPI_USE_DMA=y
```

## vendor/allwinner-a333/boot/u-boot-2018/drivers/chips/Kconfig
```kconfig
config SUNXI_CHIPS
	bool "Sunxi Chips driver"
	help
	  Enable support for chips on the Sunxi SoCs.
```
