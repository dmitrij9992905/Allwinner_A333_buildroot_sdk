## configs/Config.in
```kconfig
menu "Allwinner A333 project"

choice
	prompt "A333 product profile"
	default BR2_A333_PROFILE_DMX

config BR2_A333_PROFILE_DMX
	bool "1280x800 tablet with DMX panel"

config BR2_A333_PROFILE_MEDIA
	bool "1280x800 Bluetooth and network media tablet"

config BR2_A333_PROFILE_HEADLESS
	bool "Headless controller with display pins available as GPIO"

endchoice

config BR2_A333_KERNEL_DEBUG_LOGS
	bool "Verbose kernel boot and BSP debug logs"
	default n
	help
	  Selected by the *-kernel-debug-logs defconfigs. Keeps initcall tracing,
	  early boot console and vendor BSP debug messages. Normal profiles use
	  the quiet kernel fragment and show warnings/errors on the serial console.
	  build.sh synchronizes kernel fragments and U-Boot environment with the
	  selected profile; use a debug profile for verbose diagnostics.

choice
	prompt "Display orientation"
	default BR2_A333_DISPLAY_ORIENTATION_LANDSCAPE_CW
	help
	  Select the physical installation orientation of the native 800x1280
	  MIPI-DSI panel.  The selection is shared by the boot logo, framebuffer
	  applications and touchscreen coordinate mapping.

config BR2_A333_DISPLAY_ORIENTATION_PORTRAIT
	bool "Portrait (0 degrees)"

config BR2_A333_DISPLAY_ORIENTATION_LANDSCAPE_CW
	bool "Landscape, clockwise (90 degrees)"

config BR2_A333_DISPLAY_ORIENTATION_PORTRAIT_INVERTED
	bool "Portrait, inverted (180 degrees)"

config BR2_A333_DISPLAY_ORIENTATION_LANDSCAPE_CCW
	bool "Landscape, counter-clockwise (270 degrees)"

endchoice

config BR2_A333_DISPLAY_ROTATION
	int
	default 0 if BR2_A333_DISPLAY_ORIENTATION_PORTRAIT
	default 90 if BR2_A333_DISPLAY_ORIENTATION_LANDSCAPE_CW
	default 180 if BR2_A333_DISPLAY_ORIENTATION_PORTRAIT_INVERTED
	default 270 if BR2_A333_DISPLAY_ORIENTATION_LANDSCAPE_CCW

source "$BR2_EXTERNAL_A333_PATH/package/dmx-panel/Config.in"
source "$BR2_EXTERNAL_A333_PATH/package/media-panel/Config.in"

endmenu
```

## configs/configs/a333_helperboard_defconfig
```kconfig
BR2_aarch64=y
BR2_cortex_a53=y
BR2_KERNEL_HEADERS_6_6=y
BR2_TOOLCHAIN_BUILDROOT_GLIBC=y
BR2_TOOLCHAIN_BUILDROOT_CXX=y
BR2_CCACHE=y

BR2_TARGET_GENERIC_HOSTNAME="a333-helperboard"
BR2_TARGET_GENERIC_GETTY=y
BR2_TARGET_GENERIC_GETTY_PORT="ttyS0"
BR2_INIT_SYSTEMD=y

BR2_ROOTFS_OVERLAY="../overlays/a333/rootfs"
BR2_ROOTFS_POST_BUILD_SCRIPT="../configs/boards/a333/helperboard-a333/post-build.sh"
BR2_ROOTFS_POST_IMAGE_SCRIPT="../configs/boards/a333/helperboard-a333/post-image.sh"

BR2_TARGET_ROOTFS_EXT2=y
BR2_TARGET_ROOTFS_EXT2_4=y
BR2_TARGET_ROOTFS_EXT2_SIZE="6G"
BR2_TARGET_ROOTFS_TAR=y

BR2_PACKAGE_E2FSPROGS=y
BR2_PACKAGE_E2FSPROGS_RESIZE2FS=y
BR2_PACKAGE_UTIL_LINUX=y
BR2_PACKAGE_UTIL_LINUX_BINARIES=y
BR2_PACKAGE_GPTFDISK=y
BR2_PACKAGE_GPTFDISK_SGDISK=y

BR2_LINUX_KERNEL=y
BR2_LINUX_KERNEL_CUSTOM_TARBALL=y
BR2_LINUX_KERNEL_CUSTOM_TARBALL_LOCATION="file://$(TOPDIR)/../dl/linux-a333.tar.zst"
BR2_LINUX_KERNEL_PATCH="../configs/boards/a333/patches/linux"
BR2_LINUX_KERNEL_USE_CUSTOM_CONFIG=y
BR2_LINUX_KERNEL_CUSTOM_CONFIG_FILE="../vendor/allwinner-a333/device/a333/configs/default/linux-6.6/dragonboard_defconfig"
BR2_LINUX_KERNEL_CONFIG_FRAGMENT_FILES="../configs/boards/a333/linux-no-btf.fragment"
BR2_LINUX_KERNEL_DTS_SUPPORT=y
BR2_LINUX_KERNEL_CUSTOM_DTS_DIR="../vendor/allwinner-a333/bsp/configs/linux-6.6 ../vendor/allwinner-a333/device/a333/configs/pro/linux-6.6"
BR2_LINUX_KERNEL_IMAGE=y

BR2_TARGET_UBOOT=y
BR2_TARGET_UBOOT_BUILD_SYSTEM_KCONFIG=y
BR2_TARGET_UBOOT_CUSTOM_TARBALL=y
BR2_TARGET_UBOOT_CUSTOM_TARBALL_LOCATION="file://$(TOPDIR)/../dl/u-boot-a333.tar.zst"
BR2_TARGET_UBOOT_USE_DEFCONFIG=y
BR2_TARGET_UBOOT_BOARD_DEFCONFIG="sun65iw1p1_a333"
BR2_TARGET_UBOOT_CONFIG_FRAGMENT_FILES="../configs/boards/a333/helperboard-a333/uboot-ab.config"
BR2_TARGET_UBOOT_DEFAULT_ENV_FILE="../configs/boards/a333/helperboard-a333/env-ab.cfg"
BR2_TARGET_UBOOT_PATCH="../configs/boards/a333/patches"
BR2_TARGET_UBOOT_CUSTOM_MAKEOPTS="CROSS_COMPILE=/workspace/toolchains/gcc-linaro-7.2.1-2017.11-x86_64_arm-linux-gnueabi/bin/arm-linux-gnueabi- DTS_PATH=/workspace/output/build/uboot-custom/arch/arm/dts LICHEE_BOARD_CONFIG_DIR=/workspace/vendor/allwinner-a333/pack-sdk/device/config/chips/a333/configs/pro"
BR2_TARGET_UBOOT_FORMAT_BIN=y

BR2_PACKAGE_RAUC=y
BR2_PACKAGE_RAUC_NETWORK=y
BR2_PACKAGE_RAUC_JSON=y
BR2_PACKAGE_HOST_RAUC=y
BR2_A333_DISPLAY_ORIENTATION_LANDSCAPE_CW=y
BR2_PACKAGE_DMX_PANEL=y
BR2_PACKAGE_DBUS=y
BR2_PACKAGE_WPA_SUPPLICANT=y
BR2_PACKAGE_WPA_SUPPLICANT_NL80211=y
BR2_PACKAGE_WPA_SUPPLICANT_CLI=y
BR2_PACKAGE_WPA_SUPPLICANT_CTRL_IFACE=y
BR2_PACKAGE_IW=y
BR2_PACKAGE_I2C_TOOLS=y
BR2_PACKAGE_BLUEZ5_UTILS=y
BR2_PACKAGE_BLUEZ5_UTILS_CLIENT=y
BR2_PACKAGE_BLUEZ5_UTILS_TOOLS=y
BR2_PACKAGE_ALSA_LIB=y
BR2_PACKAGE_ALSA_UTILS=y
BR2_PACKAGE_ALSA_UTILS_AMIXER=y
BR2_PACKAGE_ALSA_UTILS_APLAY=y
BR2_PACKAGE_USBUTILS=y
BR2_PACKAGE_ANDROID_TOOLS=y
BR2_PACKAGE_ANDROID_TOOLS_ADBD=y
BR2_PACKAGE_HOST_ANDROID_TOOLS=y
BR2_PACKAGE_HOST_ANDROID_TOOLS_ADB=y
```

## configs/configs/a333_media_defconfig
```kconfig
BR2_aarch64=y
BR2_cortex_a53=y
BR2_KERNEL_HEADERS_6_6=y
BR2_TOOLCHAIN_BUILDROOT_GLIBC=y
BR2_TOOLCHAIN_BUILDROOT_CXX=y
BR2_CCACHE=y

BR2_TARGET_GENERIC_HOSTNAME="a333-media"
BR2_TARGET_GENERIC_ROOT_PASSWD="allwinner"
BR2_TARGET_GENERIC_GETTY=y
BR2_TARGET_GENERIC_GETTY_PORT="ttyS0"
BR2_INIT_SYSTEMD=y
BR2_GLOBAL_PATCH_DIR="../configs/boards/a333/global-patches"

BR2_ROOTFS_OVERLAY="../overlays/a333/rootfs ../overlays/components/display/rootfs ../overlays/components/media/rootfs"
BR2_ROOTFS_POST_BUILD_SCRIPT="../configs/boards/a333/helperboard-a333/post-build.sh"
BR2_ROOTFS_POST_IMAGE_SCRIPT="../configs/boards/a333/helperboard-a333/post-image.sh"

BR2_TARGET_ROOTFS_EXT2=y
BR2_TARGET_ROOTFS_EXT2_4=y
BR2_TARGET_ROOTFS_EXT2_SIZE="6G"
BR2_TARGET_ROOTFS_TAR=y

BR2_PACKAGE_E2FSPROGS=y
BR2_PACKAGE_E2FSPROGS_RESIZE2FS=y
BR2_PACKAGE_UTIL_LINUX=y
BR2_PACKAGE_UTIL_LINUX_BINARIES=y
BR2_PACKAGE_GPTFDISK=y
BR2_PACKAGE_GPTFDISK_SGDISK=y

BR2_LINUX_KERNEL=y
BR2_LINUX_KERNEL_CUSTOM_TARBALL=y
BR2_LINUX_KERNEL_CUSTOM_TARBALL_LOCATION="file://$(TOPDIR)/../dl/linux-a333.tar.zst"
BR2_LINUX_KERNEL_PATCH="../configs/boards/a333/patches/linux"
BR2_LINUX_KERNEL_USE_CUSTOM_CONFIG=y
BR2_LINUX_KERNEL_CUSTOM_CONFIG_FILE="../vendor/allwinner-a333/device/a333/configs/default/linux-6.6/dragonboard_defconfig"
BR2_LINUX_KERNEL_CONFIG_FRAGMENT_FILES="../configs/boards/a333/linux-no-btf.fragment"
BR2_LINUX_KERNEL_DTS_SUPPORT=y
BR2_LINUX_KERNEL_CUSTOM_DTS_DIR="../vendor/allwinner-a333/bsp/configs/linux-6.6 ../vendor/allwinner-a333/device/a333/configs/pro/linux-6.6"
BR2_LINUX_KERNEL_IMAGE=y

BR2_TARGET_UBOOT=y
BR2_TARGET_UBOOT_BUILD_SYSTEM_KCONFIG=y
BR2_TARGET_UBOOT_CUSTOM_TARBALL=y
BR2_TARGET_UBOOT_CUSTOM_TARBALL_LOCATION="file://$(TOPDIR)/../dl/u-boot-a333.tar.zst"
BR2_TARGET_UBOOT_USE_DEFCONFIG=y
BR2_TARGET_UBOOT_BOARD_DEFCONFIG="sun65iw1p1_a333"
BR2_TARGET_UBOOT_CONFIG_FRAGMENT_FILES="../configs/boards/a333/helperboard-a333/uboot-ab.config"
BR2_TARGET_UBOOT_DEFAULT_ENV_FILE="../configs/boards/a333/helperboard-a333/env-ab.cfg"
BR2_TARGET_UBOOT_PATCH="../configs/boards/a333/patches"
BR2_TARGET_UBOOT_CUSTOM_MAKEOPTS="CROSS_COMPILE=/workspace/toolchains/gcc-linaro-7.2.1-2017.11-x86_64_arm-linux-gnueabi/bin/arm-linux-gnueabi- DTS_PATH=$(BUILD_DIR)/uboot-custom/arch/arm/dts LICHEE_BOARD_CONFIG_DIR=/workspace/vendor/allwinner-a333/pack-sdk/device/config/chips/a333/configs/pro"
BR2_TARGET_UBOOT_FORMAT_BIN=y

BR2_PACKAGE_RAUC=y
BR2_PACKAGE_RAUC_NETWORK=y
BR2_PACKAGE_RAUC_JSON=y
BR2_PACKAGE_HOST_RAUC=y
BR2_A333_PROFILE_MEDIA=y
BR2_A333_DISPLAY_ORIENTATION_LANDSCAPE_CW=y
BR2_PACKAGE_BLUEZ_ALSA=y
BR2_PACKAGE_MEDIA_PANEL=y
BR2_PACKAGE_BLUEZ_ALSA_RFCOMM=y
BR2_PACKAGE_MPD=y
BR2_PACKAGE_MPD_ALSA=y
BR2_PACKAGE_MPD_CURL=y
BR2_PACKAGE_MPD_FLAC=y
BR2_PACKAGE_MPD_MPG123=y
BR2_PACKAGE_MPD_VORBIS=y
BR2_PACKAGE_MPD_LIBNFS=y
BR2_PACKAGE_MPD_MPC=y
BR2_PACKAGE_PYTHON3=y
BR2_PACKAGE_PYTHON_DBUS_NEXT=y
BR2_PACKAGE_DBUS=y
# BR2_PACKAGE_IFUPDOWN_SCRIPTS is not set
BR2_PACKAGE_NETWORK_MANAGER=y
BR2_PACKAGE_NETWORK_MANAGER_CLI=y
BR2_PACKAGE_WPA_SUPPLICANT=y
BR2_PACKAGE_WPA_SUPPLICANT_NL80211=y
BR2_PACKAGE_WPA_SUPPLICANT_CLI=y
BR2_PACKAGE_WPA_SUPPLICANT_CTRL_IFACE=y
BR2_PACKAGE_WPA_SUPPLICANT_DBUS=y
BR2_PACKAGE_WPA_SUPPLICANT_EAP=y
BR2_PACKAGE_WPA_SUPPLICANT_DBUS_INTROSPECTION=y
BR2_PACKAGE_IW=y
BR2_PACKAGE_I2C_TOOLS=y
BR2_PACKAGE_BLUEZ5_UTILS=y
BR2_PACKAGE_BLUEZ5_UTILS_CLIENT=y
BR2_PACKAGE_BLUEZ5_UTILS_MONITOR=y
BR2_PACKAGE_BLUEZ5_UTILS_TOOLS=y
BR2_PACKAGE_UTIL_LINUX_RFKILL=y
BR2_PACKAGE_ALSA_LIB=y
BR2_PACKAGE_ALSA_UTILS=y
BR2_PACKAGE_ALSA_UTILS_AMIXER=y
BR2_PACKAGE_ALSA_UTILS_APLAY=y
BR2_PACKAGE_USBUTILS=y
BR2_PACKAGE_ANDROID_TOOLS=y
BR2_PACKAGE_ANDROID_TOOLS_ADBD=y
BR2_PACKAGE_HOST_ANDROID_TOOLS=y
BR2_PACKAGE_HOST_ANDROID_TOOLS_ADB=y
BR2_PACKAGE_OPENSSH=y
BR2_PACKAGE_OPENSSH_CLIENT=y
BR2_PACKAGE_OPENSSH_SERVER=y
BR2_PACKAGE_OPENSSH_KEY_UTILS=y
# BR2_PACKAGE_SYSTEMD_NETWORKD is not set
BR2_PACKAGE_SYSTEMD_RESOLVED=y
```

## configs/package/dmx-panel/Config.in
```kconfig
config BR2_PACKAGE_DMX_PANEL
	bool "dmx-panel demo application"
	depends on BR2_TOOLCHAIN_HAS_THREADS
	help
	  LVGL framebuffer/evdev demo application for the Allwinner A333
	  1280x800 MIPI panel. The installed systemd service starts it in
	  simulation mode and does not open the RS485 device.

	  The application sources are kept in oem/a333/src/dmx-panel and
	  include the LVGL version used by the original Luckfox application.
```

## configs/package/media-panel/Config.in
```kconfig
config BR2_PACKAGE_MEDIA_PANEL
	bool "media-panel"
	depends on BR2_TOOLCHAIN_HAS_THREADS
	depends on BR2_INSTALL_LIBSTDCPP
	help
	  Touch UI for the A333 media profile, using the project's copied
	  LVGL framebuffer/evdev port and generated EEZ Flow UI (C++17).
```

## vendor/allwinner-a333/boot/u-boot-2018/configs/sun251iw1p1_h135_nor_defconfig
```kconfig
CONFIG_RISCV=y
CONFIG_SYS_CONFIG_NAME="sun251iw1p1"
CONFIG_SYS_TEXT_BASE=0x42000000
# CONFIG_SUNXI_INITRD_ROUTINE is not set
CONFIG_SUNXI_FDT_ADDR=0x41fe0000
CONFIG_SUNXI_NOR_IMG=y
CONFIG_USB0_VBUS_PIN="PD15"
CONFIG_MACH_SUN251IW1=y
CONFIG_ARCH_RV64I=y
CONFIG_SUNXI_RISCV_MODE=y
CONFIG_DEFAULT_DEVICE_TREE="sun251iw1p1-soc-system"
# CONFIG_SYS_MALLOC_CLEAR_ON_INIT is not set
CONFIG_ANDROID_BOOT_IMAGE=y
CONFIG_PRAM=7400
CONFIG_CONSOLE_MUX=y
CONFIG_RESERVE_FDT_SIZE=0x20000
CONFIG_SUNXI_SERIAL=y
CONFIG_SUNXI_MALLOC_LEN=0x1400000
CONFIG_SUNXI_MAC=y
CONFIG_SUNXI_USER_KEY=y
CONFIG_SUNXI_NECESSARY_REPLACE_FDT=y
CONFIG_SUNXI_HOMLET=y
CONFIG_SUNXI_HDCP_NO_KEYBOX=y
CONFIG_SUNXI_COMP_DETECT=y
CONFIG_CMD_PART=y
CONFIG_CMD_USB=y
CONFIG_CMD_SUNXI_TIMER=y
CONFIG_CMD_SUNXI_SPRITE=y
CONFIG_CMD_SUNXI_BURN=y
CONFIG_CMD_SUNXI_BOOTR=y
CONFIG_SUNXI_DMA=y
CONFIG_SUNXI_GPIO_V2=y

#flash
CONFIG_MMC=y
CONFIG_SPI_FLASH=y
CONFIG_SF_DEFAULT_MODE=0x3000
CONFIG_SF_DEFAULT_SPEED=20000000
CONFIG_SPI_SAMP_DL_EN=y
CONFIG_SPI_FLASH_ATMEL=y
CONFIG_SPI_FLASH_EON=y
CONFIG_SPI_FLASH_GIGADEVICE=y
CONFIG_SPI_FLASH_ISSI=y
CONFIG_SPI_FLASH_MACRONIX=y
CONFIG_SPI_FLASH_SPANSION=y
CONFIG_SPI_FLASH_STMICRO=y
CONFIG_SPI_FLASH_SST=y
CONFIG_SPI_FLASH_WINBOND=y
CONFIG_SPI_FLASH_XMC=y
CONFIG_SPI_FLASH_PUYA=y
CONFIG_SPI_FLASH_FM=y
CONFIG_SPI_FLASH_XT=y
CONFIG_SPI=y
CONFIG_SUNXI_SPI=y
CONFIG_SPI_USE_DMA=y
CONFIG_SPINOR_LOGICAL_OFFSET=2144
CONFIG_SPINOR_LOGICAL_SECURE_OFFSET=2144
CONFIG_SPINOR_SECURE_STORAGE_SIZE=64

CONFIG_USB=y
CONFIG_USB_EHCI_HCD=y
CONFIG_USB_STORAGE=y
CONFIG_BOOT_GUI=y
CONFIG_CMD_SUNXI_BMP=y
CONFIG_CMD_SUNXI_JPEG=y
CONFIG_DISP2_SUNXI=y
CONFIG_PLL_RATE_AUTO_ADJUST=y
CONFIG_SUNXI_KSC=y
CONFIG_AIOT_DISP_PARAM_UPDATE=y
CONFIG_SUNXI_PRAM_MEM=y
CONFIG_SUNXI_SDMMC=y
CONFIG_SUNXI_USB=y
CONFIG_SUNXI_EFEX=y
CONFIG_SUNXI_BURN=y
CONFIG_SUNXI_FASTBOOT=y
CONFIG_NOT_USE_OPTEE25=y
CONFIG_SUNXI_SBI_ECALL=y
CONFIG_SUNXI_FAN=y
CONFIG_SUNXI_SPRITE=y
CONFIG_SUNXI_SPRITE_CARTOON=y
CONFIG_SUNXI_SPRITE_LED=y
CONFIG_SUNXI_GPADC=y
CONFIG_SUNXI_AUTO_UPDATE=y
CONFIG_SUNXI_AUTO_UPDATE_CHECK=y
CONFIG_SUNXI_BOOT_PARAM=y
CONFIG_SUNXI_BOX_STANDBY_NG=y
```

## vendor/allwinner-a333/boot/u-boot-2018/configs/sun300iw1p1_v821_nor_defconfig
```kconfig
CONFIG_RISCV=y
CONFIG_SYS_CONFIG_NAME="sun300iw1p1"
CONFIG_SYS_TEXT_BASE=0x82000000
CONFIG_SUNXI_BOOTPKG_BASE=0xB0000000
CONFIG_SUNXI_FDT_ADDR=0x81fe0000
CONFIG_RISCV_NDS=y
CONFIG_CPU_A27L2=y
CONFIG_MACH_SUN300IW1=y
CONFIG_SUNXI_RISCV_MODE=y
CONFIG_DEFAULT_DEVICE_TREE="sun300iw1p1-soc-system"
# CONFIG_SYS_MALLOC_CLEAR_ON_INIT is not set
CONFIG_ANDROID_BOOT_IMAGE=y
CONFIG_SUNXI_SECURE_BOOT=y
CONFIG_SUNXI_ANTI_BRUSH=y
CONFIG_HASH=y
CONFIG_SHA256=y
CONFIG_CRYPTO=y
CONFIG_SUNXI_CE_06=y
CONFIG_CONSOLE_MUX=y
CONFIG_RESERVE_FDT_SIZE=0x20000
CONFIG_SUNXI_MALLOC_LEN=0x600000
CONFIG_SUNXI_MAC=y
CONFIG_SUNXI_USER_KEY=y
CONFIG_SUNXI_NECESSARY_REPLACE_FDT=y
CONFIG_SUNXI_COMP_DETECT=y
CONFIG_CMD_FASTBOOT=y
# CONFIG_CMD_GPT is not set
# CONFIG_SUNXI_SECURE_STORAGE is not set
CONFIG_CMD_PART=y
CONFIG_CMD_SUNXI_TIMER=y
CONFIG_CMD_SUNXI_SPRITE=y
CONFIG_CMD_SUNXI_BURN=y
CONFIG_CMD_SUNXI_BOOTR=y
CONFIG_CMD_USB=y
CONFIG_EFI_PARTITION=y
CONFIG_CLK_SUNXI=y
# CONFIG_CPU is not set
CONFIG_SUNXI_DMA=y
CONFIG_SUNXI_GPIO_V2=y
CONFIG_MMC=y
CONFIG_SIMULATE_MULTIPLANE=y
CONFIG_SPI_FLASH=y
CONFIG_SF_DEFAULT_MODE=0x3000
CONFIG_SF_DEFAULT_SPEED=30000000
CONFIG_SPI_SAMP_DL_EN=y
CONFIG_SPI_FLASH_ATMEL=y
CONFIG_SPI_FLASH_EON=y
CONFIG_SPI_FLASH_GIGADEVICE=y
CONFIG_SPI_FLASH_ISSI=y
CONFIG_SPI_FLASH_MACRONIX=y
CONFIG_SPI_FLASH_SPANSION=y
CONFIG_SPI_FLASH_STMICRO=y
CONFIG_SPI_FLASH_SST=y
CONFIG_SPI_FLASH_WINBOND=y
CONFIG_SPI_FLASH_XMC=y
CONFIG_SPI_FLASH_PUYA=y
CONFIG_SPI_FLASH_FM=y
CONFIG_SPI_FLASH_XT=y
CONFIG_SPI=y
CONFIG_SUNXI_SPI=y
CONFIG_SUNXI_SPIF=y
CONFIG_SYS_SUNXI_I2C0_SLAVE=0x62
CONFIG_SUNXI_POWER=y
CONFIG_AXPNULL_POWER=y
CONFIG_SUNXI_PMU=y
CONFIG_SUNXI_BMU=y
CONFIG_AXP2601_POWER=y
CONFIG_AXP2601_SUNXI_I2C_SLAVE=0x62
CONFIG_SUNXI_GPIO_NOT_CTRL_BY_POWER=y
CONFIG_SUNXI_NAND=y
CONFIG_SUNXI_UBIFS=y
CONFIG_SPINOR_LOGICAL_OFFSET=2016
CONFIG_SPINOR_UBOOT_OFFSET=128
CONFIG_SPINOR_LOGICAL_SECURE_OFFSET=2016
CONFIG_SPINOR_UBOOT_SECURE_OFFSET=128
CONFIG_SUNXI_NOR_IMG=y
CONFIG_SUNXI_SDMMC=y
CONFIG_SUNXI_USB=y
CONFIG_SUNXI_EFEX=y
CONFIG_SUNXI_BURN=y
CONFIG_NOT_USE_OPTEE25=y
CONFIG_SUNXI_SBI_ECALL=y
CONFIG_SUNXI_SPRITE=y
CONFIG_SUNXI_SPRITE_CARTOON=y
CONFIG_SUNXI_AUTO_UPDATE=y
CONFIG_USB=y
CONFIG_USB_EHCI_HCD=y
CONFIG_USB_STORAGE=y
CONFIG_USB_EHCI_SUNXI=y
CONFIG_USB_HOST_ETHER=y
CONFIG_LZ4=y
CONFIG_SYS_CACHELINE_SIZE=64

# Environment
CONFIG_ENV_IS_IN_SUNXI_FLASH=y
CONFIG_SYS_MAXARGS=64
CONFIG_SUNXI_REDUNDAND_ENVIRONMENT=y
CONFIG_SYS_REDUNDAND_ENVIRONMENT=y
CONFIG_SUNXI_ENV_PARTITION="env"
CONFIG_SUNXI_ENV_REDUNDAND_PARTITION="env-redund"
CONFIG_ENV_SIZE=0x20000

CONFIG_CMD_SUNXI_AUTO_FEL=y
CONFIG_SYS_I2C_SUNXI=y
CONFIG_I2C0_ENABLE=y
CONFIG_SYS_SUNXI_I2C0_SPEED=400000
CONFIG_SUNXI_SERIAL=y

# rtos
CONFIG_BOOT_RISCV=y
CONFIG_CMD_SUNXI_BOOTRV=y
CONFIG_SUNXI_VERIFY_RISCV=y
CONFIG_SUNXI_IMAGE_HEADER=y
```
