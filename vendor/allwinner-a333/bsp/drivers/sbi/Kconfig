## vendor/allwinner-a333/bsp/drivers/sbi/Kconfig
```kconfig
# SPDX-License-Identifier: GPL-2.0-only

menu "SBI Drivers"
	depends on AW_BSP

config AW_SBI
	tristate "Allwinner SBI Interfaces"
	depends on RISCV_SBI
	default n
	help
	  This driver support ecall interfaces depended on
	  opensbi. If you don't know whether need it, please select y.

endmenu
```

## vendor/allwinner-a333/bsp/drivers/sid/Kconfig
```kconfig
# SPDX-License-Identifier: GPL-2.0-only

menu "SID Drivers"
	depends on AW_BSP

config AW_SID
	tristate "Allwinner SID Support"
	default n
	help
	 Say Y here to enable the sunxi SID support.

config AW_SID_V2
	tristate "Allwinner SID V2"
	default n
	help
	 Say Y here to enable the sunxi SID support.

config AW_SET_EFUSE_POWER
	bool "Allwinner Set Efuse Power"
	default n
	help
	 Say Y here to enable efuse power before burn efuse.

endmenu
```

## vendor/allwinner-a333/bsp/drivers/usb/typec/tcpm/allwinner/Kconfig
```kconfig
# SPDX-License-Identifier: GPL-2.0

if TYPEC_TCPM

config AW_TYPEC_TCPCI
	tristate "Allwinner Type-C Port Controller Interface driver (Non-Standard)"
	depends on I2C
	select REGMAP_I2C
	help
	  Allwinner Type-C Port Controller driver for TCPCI-compliant controller.

	  The USB Type-C Port Controller Interface Specification define Standard TCPC
	  register map. However, the TCPC register of Allwinner self-developed PD PHY
	  integrated into the PMIC chip has a specific offset.

if AW_TYPEC_TCPCI

config TYPEC_AXP517
	tristate "Allwinner AXP517 Type-C chip driver"
	depends on USB_SUNXI_TYPEC
	depends on I2C
	help
	  Allwinner AXP517 Type-C chip driver that works with
	  Type-C Port Controller Manager to provide USB PD and USB
	  Type-C functionalities.

	  If unsure, say N.

endif # AW_TYPEC_TCPCI

endif # TYPEC_TCPM
```

## vendor/allwinner-a333/bsp/drivers/video/sunxi/lcd_fb/Kconfig
```kconfig
# SPDX-License-Identifier: GPL-2.0-or-later
#
# SPI LCD Video configuration for sunxi platform
#

menu "SPI LCD Panel Drivers"
	depends on FB
	depends on AW_BSP

config LCD_FB
	tristate "LCD FB Driver Support (SPI LCD)"
	depends on (AW_SPI_NG || AW_SPI)
	select FB_CFB_FILLRECT
	select FB_CFB_COPYAREA
	select FB_CFB_IMAGEBLIT
	select BACKLIGHT_CLASS_DEVICE
	default n
	help
	  Framebuffer implementaion for LCD panel without DE and tcon

config LCD_FB_ENABLE_DEFERRED_IO
	bool "Enable LCD_FB FB_DEFERRED_IO"
	depends on LCD_FB
	select FB_DEFERRED_IO
	default n
	help
	  Enable linux framebuffer FB_DEFERRED_IO for LCD_FB

menu "LCD FB Panels select"
	depends on LCD_FB
source "$(BSP_TOP)drivers/video/sunxi/lcd_fb/panels/Kconfig"
endmenu

endmenu
```

## vendor/allwinner-a333/bsp/drivers/xenomai/Kconfig
```kconfig
# SPDX-License-Identifier: GPL-2.0-only

menu "Xenomai Device Drivers"

config AW_XENOMAI_DRIVERS
	bool "Enable allwinner drivers for RTDM devices"
	depends on XENO_OPT_RTDM_COMPAT_DEVNODE
	default n
	help
		Enable allwinner drivers for RTDM devices

source "$(BSP_TOP)/drivers/xenomai/spi/Kconfig"

endmenu
```

## vendor/allwinner-a333/bsp/drivers/xenomai/spi/Kconfig
```kconfig
# SPDX-License-Identifier: GPL-2.0

menu "AW Real-time SPI master drivers"
	depends on AW_XENOMAI_DRIVERS

config AW_XENO_DRIVERS_SPI
	tristate "Xenomai SPI NG Driver Support for Allwinner SoCs"
	depends on OF && (ARCH_SUNXI || ARCH_RV32I || COMPILE_TEST)
	default n
	select SPI
	help
	  Enable SPI Xenomai Driver Support for Allwinner SoCs.

config AW_XENO_DRIVERS_SPI_BIT
	bool "Support driver bit-aligned feature"
	depends on AW_XENO_DRIVERS_SPI
	default y

config AW_XENO_DRIVERS_SPI_DBI
	bool "Support driver dbi feature"
	depends on AW_XENO_DRIVERS_SPI
	default y

config AW_XENO_DRIVERS_SPI_CAMERA
	bool "Support driver camera feature"
	depends on AW_XENO_DRIVERS_SPI
	default y

config AW_XENO_DRIVERS_SPI_ATOMIC_XFER
	bool "Support atomic xfer function"
	depends on AW_XENO_DRIVERS_SPI
	default n
	help
	  Enable SPI controller atomic xfer function, support transfer under
	  no-irq/no-dma/no-schedule/no-suspend-resume env. (Such as kernel panic)
endmenu
```

## vendor/allwinner-a333/device/a333/configs/default/linux-6.6/dragonboard_defconfig
```kconfig
CONFIG_AW_BSP=y
CONFIG_ARCH_SUN65I=y
CONFIG_AW_IC_BOARD=y
CONFIG_AW_SOC_NAME="A537"
# CONFIG_AW_DDR_CCU is not set
# CONFIG_AW_UART is not set
CONFIG_AW_UART_NG=y
CONFIG_AW_SERIAL_CONSOLE=y
CONFIG_AW_SERLAL_NR_UARTS=9
CONFIG_AW_TIMER=y
CONFIG_AW_TIMER_SUN50I=y
CONFIG_AW_DMA=y
CONFIG_AW_RTC=y
CONFIG_AW_RTC_REBOOT_FLAG=y
CONFIG_AW_RTC_POWEROFF_ALARM=y
CONFIG_AW_NSI=y
CONFIG_AW_NSI_DISTRIBUTE=y
CONFIG_AW_NSI_CPU_CHANNEL=y
CONFIG_AW_WATCHDOG=y
CONFIG_AW_IOMMU=y
CONFIG_AW_IOMMU_V3=y
CONFIG_AW_MMC=y
CONFIG_AW_VIDEO_SUNXI_VIN=m
CONFIG_ACTUATOR=m
CONFIG_ACTUATOR_DW9714=m
CONFIG_SUPPORT_ISP_TDM=y
CONFIG_TDM_LBC_EN=y
CONFIG_VIN_IOMMU=y
CONFIG_D3D=y
# CONFIG_SAME_I2C is not set
CONFIG_SENSOR_OV13850=m
CONFIG_SENSOR_OV5648_MIPI=m
CONFIG_SENSOR_OV8858_R2A_4LANE=m
CONFIG_SENSOR_GC2093_MIPI=m
CONFIG_AW_DRM=y
CONFIG_AW_DRM_LVDS=y
CONFIG_AW_DRM_DSI=y
# CONFIG_AW_DRM_HDMI_TX is not set
CONFIG_AW_DRM_EDP=y
CONFIG_AW_DRM_INNO_EDP13=y
CONFIG_PANEL_DSI_GENERAL=y
CONFIG_PANEL_LVDS_GENERAL=y
CONFIG_PANEL_EDP_GENERAL=y
CONFIG_AW_DRM_PHY=y
CONFIG_AW_DRM_DSI_COMBOPHY=y
CONFIG_SND_SOC_SUNXI_AAUDIO=y
# CONFIG_SND_SOC_SUNXI_DYNAMIC_DEBUG is not set
CONFIG_AW_SID=y
CONFIG_AW_SYNOPSYS_COMBOPHY=y
CONFIG_AW_STMMAC_ETH=m
CONFIG_AW_STMMAC_SELFTESTS=y
CONFIG_USB_SUNXI_DWC3=y
CONFIG_PHY_SUNXI_PLAT=y
CONFIG_USB_EHCI_HCD_SUNXI=y
CONFIG_USB_OHCI_HCD_SUNXI=y
CONFIG_USB_SUNXI_HCD=y
CONFIG_USB_SUNXI_HCI=y
CONFIG_USB_SUNXI_EHCI0=y
CONFIG_USB_SUNXI_EHCI1=y
CONFIG_USB_SUNXI_OHCI0=y
CONFIG_USB_SUNXI_OHCI1=y
CONFIG_USB_SUNXI_USB=y
CONFIG_USB_SUNXI_USB_MANAGER=y
CONFIG_USB_SUNXI_USB_DEBUG=y
CONFIG_USB_SUNXI_USB_ADB=y
CONFIG_USB_SUNXI_UDC0=y
CONFIG_USB_SUNXI_TYPEC=y
CONFIG_TYPEC_MUX_SUNXI_PHY_SWITCHER=y
CONFIG_USB_SUNXI_EXTCON=y
CONFIG_EXTCON_SUNXI_PLAT=y
CONFIG_EXTCON_SUNXI_USB_GPIO=y
CONFIG_USB_SUNXI_PHY=y
CONFIG_USB_SUNXI_AWPHY=y
CONFIG_AW_TWI=y
CONFIG_AW_LEDC=y
CONFIG_AW_PWM=y
CONFIG_AW_GPADC=y
CONFIG_AW_LRADC=y
CONFIG_AW_INPUT_SENSORINIT=y
CONFIG_AW_INPUT_CTP=y
# CONFIG_TOUCHSCREEN_GSLX680NEW is not set
CONFIG_TOUCHSCREEN_GT9XXNEW_TS=y
# CONFIG_TOUCHSCREEN_CHIPONE is not set
CONFIG_AW_INPUT_SENSOR=y
CONFIG_AW_INPUT_MISC=y
CONFIG_AW_HALL_SENSOR=m
CONFIG_AIC_WLAN_SUPPORT=y
CONFIG_PLATFORM_UBUNTU=y
CONFIG_USE_P2P0=y
CONFIG_AIC8800_WLAN_SUPPORT=m
CONFIG_AIC8800_BTLPM_SUPPORT=m
CONFIG_AW_WAKEUPGEN=y
CONFIG_AW_SUN8I_NMI=y
CONFIG_AW_THERMAL=y
CONFIG_AW_EXT_THERMAL_ZONE=y
CONFIG_AW_PM_DOMAINS=y
CONFIG_AW_PCK600_DOMAINS=y
CONFIG_AW_POWER_DOMAIN_TEST=y
CONFIG_AW_MFD_AXP2101_I2C=y
CONFIG_AW_MFD_PMU_EXT_I2C=y
CONFIG_AW_REGULATOR_AXP2101=y
CONFIG_AW_REGULATOR_PMU_EXT=y
CONFIG_AW_AXP1530_WORKAROUND_DVM=y
CONFIG_AW_INPUT_AXP2101_PEK=y
CONFIG_AW_AXP2202_POWER=y
CONFIG_AW_AXP2202_GPIO_POWER=y
CONFIG_AW_CPUFREQ_DT=y
CONFIG_ARM_AW_SUN50I_CPUFREQ_NVMEM=y
CONFIG_AW_SUNXI_DSUFREQ=y
CONFIG_AW_RFKILL=y
CONFIG_AW_MACADDR_MGT=y
CONFIG_AW_CRASHDUMP=y
CONFIG_FAT_DEFAULT_IOCHARSET="utf8"
CONFIG_FAT_DEFAULT_UTF8=y
CONFIG_AW_GPU_TYPE="mali-g57-r50p0"
# CONFIG_LOCALVERSION_AUTO is not set
CONFIG_SYSVIPC=y
CONFIG_NO_HZ=y
CONFIG_HIGH_RES_TIMERS=y
CONFIG_PREEMPT=y
CONFIG_IKCONFIG=y
CONFIG_IKCONFIG_PROC=y
CONFIG_CGROUPS=y
CONFIG_MEMCG=y
CONFIG_BLK_CGROUP=y
CONFIG_CGROUP_SCHED=y
CONFIG_CGROUP_FREEZER=y
CONFIG_CGROUP_CPUACCT=y
CONFIG_NAMESPACES=y
# CONFIG_UTS_NS is not set
# CONFIG_PID_NS is not set
CONFIG_BLK_DEV_INITRD=y
# CONFIG_RD_BZIP2 is not set
# CONFIG_RD_LZMA is not set
# CONFIG_RD_XZ is not set
# CONFIG_RD_LZO is not set
# CONFIG_RD_LZ4 is not set
# CONFIG_RD_ZSTD is not set
CONFIG_EXPERT=y
# CONFIG_SYSFS_SYSCALL is not set
# CONFIG_FHANDLE is not set
# CONFIG_AIO is not set
# CONFIG_IO_URING is not set
CONFIG_KALLSYMS_ALL=y
# CONFIG_RSEQ is not set
# CONFIG_PERF_EVENTS is not set
CONFIG_PROFILING=y
CONFIG_NR_CPUS=7
CONFIG_COMPAT=y
# CONFIG_EFI is not set
CONFIG_PM_USERSPACE_AUTOSLEEP=y
CONFIG_PM_WAKELOCKS=y
CONFIG_ENERGY_MODEL=y
CONFIG_CPU_IDLE=y
CONFIG_ARM_PSCI_CPUIDLE=y
CONFIG_CPU_FREQ=y
CONFIG_CPU_FREQ_STAT=y
CONFIG_CPU_FREQ_TIMES=y
CONFIG_CPU_FREQ_GOV_POWERSAVE=y
CONFIG_CPU_FREQ_GOV_USERSPACE=y
CONFIG_CPU_FREQ_GOV_ONDEMAND=y
CONFIG_CPU_FREQ_GOV_CONSERVATIVE=y
CONFIG_MODULES=y
CONFIG_MODULE_UNLOAD=y
CONFIG_BLK_CGROUP_IOCOST=y
CONFIG_BLK_CGROUP_IOPRIO=y
# CONFIG_IOSCHED_BFQ is not set
# CONFIG_CORE_DUMP_DEFAULT_ELF_HEADERS is not set
# CONFIG_SWAP is not set
# CONFIG_SLAB_MERGE_DEFAULT is not set
# CONFIG_COMPAT_BRK is not set
CONFIG_CMA=y
CONFIG_NET=y
CONFIG_PACKET=y
CONFIG_PACKET_DIAG=y
CONFIG_UNIX=y
CONFIG_UNIX_DIAG=y
CONFIG_NET_KEY=y
CONFIG_NET_KEY_MIGRATE=y
CONFIG_INET=y
CONFIG_IP_MULTICAST=y
CONFIG_IP_ADVANCED_ROUTER=y
CONFIG_IP_FIB_TRIE_STATS=y
CONFIG_IP_MULTIPLE_TABLES=y
CONFIG_IP_ROUTE_MULTIPATH=y
CONFIG_IP_ROUTE_VERBOSE=y
CONFIG_IP_PNP=y
CONFIG_IP_PNP_DHCP=y
CONFIG_IP_PNP_BOOTP=y
CONFIG_IP_PNP_RARP=y
CONFIG_NET_IPIP=y
CONFIG_NET_IPGRE_DEMUX=y
CONFIG_NET_IPGRE=y
CONFIG_NET_IPGRE_BROADCAST=y
CONFIG_IP_MROUTE=y
CONFIG_IP_MROUTE_MULTIPLE_TABLES=y
CONFIG_IP_PIMSM_V1=y
CONFIG_IP_PIMSM_V2=y
CONFIG_SYN_COOKIES=y
CONFIG_NET_FOU_IP_TUNNELS=y
CONFIG_INET_UDP_DIAG=y
CONFIG_INET_RAW_DIAG=y
CONFIG_INET_DIAG_DESTROY=y
CONFIG_TCP_CONG_ADVANCED=y
CONFIG_TCP_MD5SIG=y
CONFIG_NETFILTER=y
CONFIG_NF_CONNTRACK=y
CONFIG_NF_CONNTRACK_PROCFS=y
CONFIG_NF_CONNTRACK_EVENTS=y
CONFIG_NF_CONNTRACK_AMANDA=y
CONFIG_NF_CONNTRACK_FTP=y
CONFIG_NF_CONNTRACK_H323=y
CONFIG_NF_CONNTRACK_IRC=y
CONFIG_NF_CONNTRACK_NETBIOS_NS=y
CONFIG_NF_CONNTRACK_SNMP=y
CONFIG_NF_CONNTRACK_PPTP=y
CONFIG_NF_CONNTRACK_SANE=y
CONFIG_NF_CONNTRACK_SIP=y
CONFIG_NF_CONNTRACK_TFTP=y
CONFIG_NF_CT_NETLINK=y
CONFIG_NF_NAT=y
CONFIG_NETFILTER_XTABLES=y
CONFIG_NETFILTER_XT_TARGET_CLASSIFY=y
CONFIG_NETFILTER_XT_TARGET_CONNMARK=y
CONFIG_NETFILTER_XT_TARGET_HMARK=y
CONFIG_NETFILTER_XT_TARGET_IDLETIMER=y
CONFIG_NETFILTER_XT_TARGET_LED=y
CONFIG_NETFILTER_XT_TARGET_MARK=y
CONFIG_NETFILTER_XT_NAT=y
CONFIG_NETFILTER_XT_TARGET_NETMAP=y
CONFIG_NETFILTER_XT_TARGET_NFLOG=y
CONFIG_NETFILTER_XT_TARGET_NFQUEUE=y
CONFIG_NETFILTER_XT_TARGET_RATEEST=y
CONFIG_NETFILTER_XT_TARGET_REDIRECT=y
CONFIG_NETFILTER_XT_TARGET_MASQUERADE=y
CONFIG_NETFILTER_XT_TARGET_TEE=y
CONFIG_NETFILTER_XT_TARGET_TCPMSS=y
CONFIG_NETFILTER_XT_MATCH_BPF=y
CONFIG_NETFILTER_XT_MATCH_COMMENT=y
CONFIG_NETFILTER_XT_MATCH_CONNBYTES=y
CONFIG_NETFILTER_XT_MATCH_CONNLIMIT=y
CONFIG_NETFILTER_XT_MATCH_CONNMARK=y
CONFIG_NETFILTER_XT_MATCH_CONNTRACK=y
CONFIG_NETFILTER_XT_MATCH_DSCP=y
CONFIG_NETFILTER_XT_MATCH_ECN=y
CONFIG_NETFILTER_XT_MATCH_ESP=y
CONFIG_NETFILTER_XT_MATCH_HASHLIMIT=y
CONFIG_NETFILTER_XT_MATCH_HELPER=y
CONFIG_NETFILTER_XT_MATCH_HL=y
CONFIG_NETFILTER_XT_MATCH_IPRANGE=y
CONFIG_NETFILTER_XT_MATCH_L2TP=y
CONFIG_NETFILTER_XT_MATCH_LENGTH=y
CONFIG_NETFILTER_XT_MATCH_LIMIT=y
CONFIG_NETFILTER_XT_MATCH_MAC=y
CONFIG_NETFILTER_XT_MATCH_MARK=y
CONFIG_NETFILTER_XT_MATCH_MULTIPORT=y
CONFIG_NETFILTER_XT_MATCH_OWNER=y
CONFIG_NETFILTER_XT_MATCH_POLICY=y
CONFIG_NETFILTER_XT_MATCH_PKTTYPE=y
CONFIG_NETFILTER_XT_MATCH_QUOTA=y
CONFIG_NETFILTER_XT_MATCH_QUOTA2=y
CONFIG_NETFILTER_XT_MATCH_QUOTA2_LOG=y
CONFIG_NETFILTER_XT_MATCH_SOCKET=y
CONFIG_NETFILTER_XT_MATCH_STATE=y
CONFIG_NETFILTER_XT_MATCH_STATISTIC=y
CONFIG_NETFILTER_XT_MATCH_STRING=y
CONFIG_NETFILTER_XT_MATCH_TCPMSS=y
CONFIG_NETFILTER_XT_MATCH_TIME=y
CONFIG_NETFILTER_XT_MATCH_U32=y
CONFIG_DNS_RESOLVER=y
CONFIG_CGROUP_NET_PRIO=y
CONFIG_BT=y
CONFIG_BT_RFCOMM=y
CONFIG_BT_RFCOMM_TTY=y
CONFIG_BT_HCIUART=y
CONFIG_BT_HCIUART_H4=y
CONFIG_CFG80211=y
CONFIG_MAC80211=y
CONFIG_RFKILL=y
CONFIG_DEVTMPFS=y
# CONFIG_ALLOW_DEV_COREDUMP is not set
# CONFIG_SUN50I_DE2_BUS is not set
# CONFIG_SUNXI_RSB is not set
# CONFIG_BLK_DEV is not set
CONFIG_SCSI=y
CONFIG_BLK_DEV_SD=y
CONFIG_STMMAC_ETH=y
CONFIG_DWMAC_GENERIC=m
CONFIG_DWMAC_SUNXI=m
CONFIG_DWMAC_SUN8I=m
CONFIG_PPP=y
CONFIG_PPP_BSDCOMP=y
CONFIG_PPP_DEFLATE=y
CONFIG_PPP_FILTER=y
CONFIG_PPP_MPPE=y
CONFIG_PPP_MULTILINK=y
CONFIG_PPPOE=y
CONFIG_PPTP=y
CONFIG_PPP_ASYNC=y
CONFIG_PPP_SYNC_TTY=y
CONFIG_USB_USBNET=y
CONFIG_USB_NET_RNDIS_HOST=y
CONFIG_USB_NET_QMI_WWAN=y
CONFIG_KEYBOARD_GPIO=y
# CONFIG_SERIO_SERPORT is not set
# CONFIG_LEGACY_PTYS is not set
# CONFIG_HW_RANDOM is not set
# CONFIG_PTP_1588_CLOCK is not set
# CONFIG_PINCTRL_SUN8I_H3_R is not set
# CONFIG_PINCTRL_SUN50I_A64 is not set
# CONFIG_PINCTRL_SUN50I_A64_R is not set
# CONFIG_PINCTRL_SUN50I_A100 is not set
# CONFIG_PINCTRL_SUN50I_A100_R is not set
# CONFIG_PINCTRL_SUN50I_H5 is not set
# CONFIG_PINCTRL_SUN50I_H6 is not set
# CONFIG_PINCTRL_SUN50I_H6_R is not set
# CONFIG_PINCTRL_SUN50I_H616 is not set
# CONFIG_PINCTRL_SUN50I_H616_R is not set
CONFIG_GPIO_SYSFS=y
# CONFIG_HWMON is not set
CONFIG_THERMAL_STATISTICS=y
CONFIG_THERMAL_WRITABLE_TRIPS=y
CONFIG_THERMAL_DEFAULT_GOV_POWER_ALLOCATOR=y
CONFIG_THERMAL_GOV_FAIR_SHARE=y
CONFIG_THERMAL_GOV_STEP_WISE=y
CONFIG_THERMAL_GOV_BANG_BANG=y
CONFIG_THERMAL_GOV_USER_SPACE=y
CONFIG_THERMAL_GOV_POWER_ALLOCATOR=y
CONFIG_CPU_THERMAL=y
CONFIG_CPU_IDLE_THERMAL=y
CONFIG_DEVFREQ_THERMAL=y
CONFIG_THERMAL_EMULATION=y
CONFIG_REGULATOR_FIXED_VOLTAGE=y
# CONFIG_MEDIA_CEC_SUPPORT is not set
CONFIG_MEDIA_SUPPORT=y
CONFIG_DRM=y
CONFIG_FB=y
CONFIG_FRAMEBUFFER_CONSOLE_DEFERRED_TAKEOVER=y
CONFIG_SOUND=y
CONFIG_SND=y
CONFIG_SND_USB_AUDIO=y
CONFIG_SND_SOC=y
CONFIG_USB=y
CONFIG_USB_ANNOUNCE_NEW_DEVICES=y
CONFIG_USB_XHCI_HCD=y
CONFIG_USB_EHCI_HCD=y
CONFIG_USB_EHCI_ROOT_HUB_TT=y
CONFIG_USB_OHCI_HCD=y
CONFIG_USB_OHCI_HCD_PLATFORM=y
CONFIG_USB_ACM=y
CONFIG_USB_STORAGE=y
CONFIG_USB_STORAGE_REALTEK=y
CONFIG_USB_STORAGE_DATAFAB=y
CONFIG_USB_STORAGE_FREECOM=y
CONFIG_USB_STORAGE_ISD200=y
CONFIG_USB_STORAGE_USBAT=y
CONFIG_USB_STORAGE_SDDR09=y
CONFIG_USB_STORAGE_SDDR55=y
CONFIG_USB_STORAGE_JUMPSHOT=y
CONFIG_USB_STORAGE_ALAUDA=y
CONFIG_USB_STORAGE_ONETOUCH=y
CONFIG_USB_STORAGE_KARMA=y
CONFIG_USB_STORAGE_CYPRESS_ATACB=y
CONFIG_USB_STORAGE_ENE_UB6250=y
CONFIG_USB_UAS=y
CONFIG_USB_DWC3=y
CONFIG_USB_SERIAL=y
CONFIG_USB_SERIAL_OPTION=y
CONFIG_USB_GADGET=y
CONFIG_USB_CONFIGFS=y
CONFIG_ANDROID_USB_CONFIGFS_UEVENT=y
CONFIG_USB_CONFIGFS_SERIAL=y
CONFIG_USB_CONFIGFS_ACM=y
CONFIG_USB_CONFIGFS_NCM=y
CONFIG_USB_CONFIGFS_ECM=y
CONFIG_USB_CONFIGFS_RNDIS=y
CONFIG_USB_CONFIGFS_EEM=y
CONFIG_USB_CONFIGFS_MASS_STORAGE=y
CONFIG_USB_CONFIGFS_F_FS=y
CONFIG_USB_CONFIGFS_F_UAC2=y
CONFIG_USB_CONFIGFS_F_MIDI=y
CONFIG_USB_CONFIGFS_F_HID=y
CONFIG_ANDROID_USB_CONFIGFS_F_ACC=y
CONFIG_TYPEC=y
CONFIG_TYPEC_TCPM=y
CONFIG_TYPEC_TCPCI=y
CONFIG_TYPEC_UCSI=y
CONFIG_TYPEC_DP_ALTMODE=y
CONFIG_MMC=y
# CONFIG_PWRSEQ_EMMC is not set
# CONFIG_PWRSEQ_SIMPLE is not set
CONFIG_MMC_CQHCI=y
CONFIG_MMC_HSQ=y
CONFIG_DMABUF_HEAPS=y
CONFIG_DMABUF_HEAPS_SYSTEM=y
CONFIG_DMABUF_HEAPS_CMA=y
# CONFIG_SUNXI_CCU is not set
# CONFIG_ARM_ARCH_TIMER_EVTSTREAM is not set
# CONFIG_FSL_ERRATUM_A008585 is not set
# CONFIG_HISILICON_ERRATUM_161010101 is not set
# CONFIG_ARM64_ERRATUM_858921 is not set
# CONFIG_SUN50I_ERRATUM_UNKNOWN1 is not set
CONFIG_PM_DEVFREQ=y
CONFIG_IIO=y
CONFIG_POWERCAP=y
CONFIG_IDLE_INJECT=y
CONFIG_EXT4_FS=y
# CONFIG_DNOTIFY is not set
CONFIG_MSDOS_FS=y
CONFIG_VFAT_FS=y
CONFIG_EXFAT_FS=y
CONFIG_NTFS_FS=y
CONFIG_NTFS_DEBUG=y
CONFIG_NTFS_RW=y
CONFIG_NTFS3_FS=y
CONFIG_NTFS3_64BIT_CLUSTER=y
CONFIG_NTFS3_LZX_XPRESS=y
CONFIG_NTFS3_FS_POSIX_ACL=y
CONFIG_TMPFS=y
# CONFIG_MISC_FILESYSTEMS is not set
CONFIG_NLS_DEFAULT="utf-8"
CONFIG_NLS_CODEPAGE_437=y
CONFIG_NLS_CODEPAGE_936=y
CONFIG_NLS_CODEPAGE_950=y
CONFIG_NLS_ISO8859_1=y
CONFIG_NLS_UTF8=y
CONFIG_XZ_DEC=y
CONFIG_DMA_CMA=y
CONFIG_PRINTK_TIME=y
CONFIG_PRINTK_CALLER=y
CONFIG_MESSAGE_LOGLEVEL_DEFAULT=7
# CONFIG_DEBUG_MISC is not set
CONFIG_DEBUG_INFO_DWARF5=y
# CONFIG_SECTION_MISMATCH_WARN_ONLY is not set
CONFIG_MAGIC_SYSRQ=y
CONFIG_DEBUG_FS=y
CONFIG_PANIC_ON_OOPS=y
CONFIG_DEBUG_MAPLE_TREE=y
# CONFIG_FTRACE is not set
```
